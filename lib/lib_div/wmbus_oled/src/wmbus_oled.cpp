// SPDX-License-Identifier: Apache-2.0
//
// Minimal SSD1306 driver. See header for description.
// Font: public-domain 5x7 ASCII bitmap (Codepage 437 derivative, 0x20..0x7E).

#include "wmbus_oled.h"

namespace {

// --- 5x7 font, column-major, LSB = top pixel ----------------------------
// 95 printable ASCII chars (0x20 .. 0x7E), 5 bytes each.
// Compact public-domain table (commonly redistributed; e.g. derived from the
// IBM CGA 8x8 font reduced to 5x7).
const uint8_t kFont5x7[95][5] PROGMEM = {
  {0x00,0x00,0x00,0x00,0x00}, // 0x20 ' '
  {0x00,0x00,0x5F,0x00,0x00}, // 0x21 '!'
  {0x00,0x07,0x00,0x07,0x00}, // 0x22 '"'
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  {0x02,0x01,0x02,0x04,0x02}, // 0x7E '~'
};

// SSD1306 command opcodes used in the init sequence.
constexpr uint8_t kCmdDisplayOff       = 0xAE;
constexpr uint8_t kCmdDisplayOn        = 0xAF;
constexpr uint8_t kCmdSetDisplayClock  = 0xD5;
constexpr uint8_t kCmdSetMultiplex     = 0xA8;
constexpr uint8_t kCmdSetDisplayOffset = 0xD3;
constexpr uint8_t kCmdSetStartLine     = 0x40;
constexpr uint8_t kCmdChargePump       = 0x8D;
constexpr uint8_t kCmdMemoryMode       = 0x20;
constexpr uint8_t kCmdSegRemap         = 0xA1;   // column 127 mapped to SEG0
constexpr uint8_t kCmdComScanDec       = 0xC8;
constexpr uint8_t kCmdSetComPins       = 0xDA;
constexpr uint8_t kCmdSetContrast      = 0x81;
constexpr uint8_t kCmdSetPrecharge     = 0xD9;
constexpr uint8_t kCmdSetVComDetect    = 0xDB;
constexpr uint8_t kCmdDisplayAllOnResume = 0xA4;
constexpr uint8_t kCmdNormalDisplay    = 0xA6;
constexpr uint8_t kCmdDeactivateScroll = 0x2E;
constexpr uint8_t kCmdColumnAddr       = 0x21;
constexpr uint8_t kCmdPageAddr         = 0x22;

}  // namespace

WmbusOled::WmbusOled()
    : wire_(nullptr), addr_(0x3C), cursor_col_(0), cursor_row_(0) {
  memset(fb_, 0, sizeof(fb_));
}

void WmbusOled::cmd_(uint8_t c) {
  wire_->beginTransmission(addr_);
  wire_->write((uint8_t)0x00);   // Co=0, D/C#=0 → command stream
  wire_->write(c);
  wire_->endTransmission();
}

void WmbusOled::cmdList_(const uint8_t *list, uint8_t n) {
  wire_->beginTransmission(addr_);
  wire_->write((uint8_t)0x00);
  for (uint8_t i = 0; i < n; ++i) wire_->write(list[i]);
  wire_->endTransmission();
}

bool WmbusOled::begin(TwoWire &wire, uint8_t i2c_addr) {
  wire_ = &wire;
  addr_ = i2c_addr;

  // Probe: address must ACK
  wire_->beginTransmission(addr_);
  if (wire_->endTransmission() != 0) {
    return false;
  }

  static const uint8_t init_seq[] PROGMEM = {
    kCmdDisplayOff,
    kCmdSetDisplayClock,    0x80,
    kCmdSetMultiplex,       0x3F,        // 64 rows
    kCmdSetDisplayOffset,   0x00,
    (uint8_t)(kCmdSetStartLine | 0x00),
    kCmdChargePump,         0x14,        // enable internal VCC charge pump
    kCmdMemoryMode,         0x00,        // horizontal addressing
    kCmdSegRemap,
    kCmdComScanDec,
    kCmdSetComPins,         0x12,        // alt COM pin config, no remap (128x64)
    kCmdSetContrast,        0xCF,
    kCmdSetPrecharge,       0xF1,
    kCmdSetVComDetect,      0x40,
    kCmdDisplayAllOnResume,
    kCmdNormalDisplay,
    kCmdDeactivateScroll,
    kCmdDisplayOn,
  };
  uint8_t buf[sizeof(init_seq)];
  memcpy_P(buf, init_seq, sizeof(init_seq));
  cmdList_(buf, sizeof(buf));

  clear();
  display();
  return true;
}

void WmbusOled::clear() {
  memset(fb_, 0, sizeof(fb_));
  cursor_col_ = 0;
  cursor_row_ = 0;
}

void WmbusOled::setCursor(uint8_t col, uint8_t row) {
  if (col >= kCols) col = kCols - 1;
  if (row >= kRows) row = kRows - 1;
  cursor_col_ = col;
  cursor_row_ = row;
}

void WmbusOled::setPixel(uint8_t x, uint8_t y, bool on) {
  if (x >= kWidth || y >= kHeight) return;
  const size_t idx  = (size_t)(y >> 3) * kWidth + x;
  const uint8_t bit = 1u << (y & 7);
  if (on) fb_[idx] |=  bit;
  else    fb_[idx] &= ~bit;
}

void WmbusOled::drawChar(uint8_t col, uint8_t row, char c, bool invert) {
  if (col >= kCols || row >= kRows) return;
  uint8_t glyph[5];
  if ((uint8_t)c < 0x20 || (uint8_t)c > 0x7E) c = '?';
  memcpy_P(glyph, kFont5x7[(uint8_t)c - 0x20], 5);

  const uint16_t x = (uint16_t)col * kFontW;
  const size_t   page_idx = (size_t)row * kWidth + x;
  for (uint8_t i = 0; i < 5; ++i) {
    uint8_t b = glyph[i];
    if (invert) b = ~b;
    fb_[page_idx + i] = b;
  }
  // spacing column
  fb_[page_idx + 5] = invert ? 0xFF : 0x00;
}

void WmbusOled::drawString(uint8_t col, uint8_t row, const char *s, bool invert) {
  while (*s && col < kCols) {
    drawChar(col, row, *s, invert);
    ++col;
    ++s;
  }
}

void WmbusOled::drawHLine(uint8_t y) {
  if (y >= kHeight) return;
  const size_t  page = (size_t)(y >> 3) * kWidth;
  const uint8_t bit  = 1u << (y & 7);
  for (uint8_t x = 0; x < kWidth; ++x) fb_[page + x] |= bit;
}

size_t WmbusOled::write(uint8_t c) {
  if (c == '\n') {
    cursor_col_ = 0;
    if (cursor_row_ + 1 < kRows) ++cursor_row_;
    return 1;
  }
  if (c == '\r') {
    cursor_col_ = 0;
    return 1;
  }
  if (cursor_col_ >= kCols) {
    cursor_col_ = 0;
    if (cursor_row_ + 1 < kRows) ++cursor_row_;
    else                         return 1;
  }
  drawChar(cursor_col_, cursor_row_, (char)c, false);
  ++cursor_col_;
  return 1;
}

void WmbusOled::display() {
  // Address the full 128x64 window once
  const uint8_t window[] = {
    kCmdColumnAddr, 0x00, (uint8_t)(kWidth - 1),
    kCmdPageAddr,   0x00, (uint8_t)(kPages - 1),
  };
  cmdList_(window, sizeof(window));

  // Bulk-write the framebuffer in 16-byte chunks (Wire buffer is 32 bytes on
  // ESP32/8266; 1 byte is the data prefix).
  for (size_t off = 0; off < kFbSize; off += 16) {
    wire_->beginTransmission(addr_);
    wire_->write((uint8_t)0x40);             // Co=0, D/C#=1 → data stream
    const size_t n = (off + 16 <= kFbSize) ? 16 : (kFbSize - off);
    wire_->write(fb_ + off, n);
    wire_->endTransmission();
  }
}

void WmbusOled::setContrast(uint8_t value) {
  const uint8_t seq[] = { kCmdSetContrast, value };
  cmdList_(seq, sizeof(seq));
}

void WmbusOled::powerOn()  { cmd_(kCmdDisplayOn);  }
void WmbusOled::powerOff() { cmd_(kCmdDisplayOff); }
